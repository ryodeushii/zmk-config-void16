## config/boards/shields/void16/Kconfig.defconfig
```kconfig
    # Copyright (c) 2022 The ZMK Contributors
# SPDX-License-Identifier: MIT

if SHIELD_VOID16

config ZMK_KEYBOARD_NAME
    default "VOID16"

endif # SHIELD_VOID16
```

## config/boards/shields/void16/Kconfig.shield
```kconfig
# Copyright (c) 2022 The ZMK Contributors
# SPDX-License-Identifier: MIT

config SHIELD_VOID16
    def_bool $(shields_list_contains,void16)
```
